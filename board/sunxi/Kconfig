## board/sunxi/Kconfig
```kconfig
choice
	prompt "SPL Image Type"
	default SPL_IMAGE_TYPE_SUNXI_EGON

config SPL_IMAGE_TYPE_SUNXI_EGON
	bool "eGON (normal)"
	help
	  Select this option to embed the SPL binary in an eGON.BT0 image,
	  which is compatible with the normal boot ROM (NBROM).

	  This is usually the correct option to choose.

config SPL_IMAGE_TYPE_SUNXI_TOC0
	bool "TOC0 (secure)"
	help
	  Select this option to embed the SPL binary in a TOC0 image,
	  which is compatible with the secure boot ROM (SBROM).

endchoice

config SPL_IMAGE_TYPE
	string
	default "sunxi_egon" if SPL_IMAGE_TYPE_SUNXI_EGON
	default "sunxi_toc0" if SPL_IMAGE_TYPE_SUNXI_TOC0

config SUNXI_NAND_SECURE_STORAGE
	bool "Allwinner NAND secure storage support"
	depends on NAND_SUNXI && MTD_RAW_NAND
	help
	  Enable support for reading the Allwinner BSP raw NAND secure-storage
	  area from U-Boot proper. This is used by some sunxi boards to
	  preserve BSP factory data, such as MAC addresses, when booting a
	  mainline NAND layout.

config SUNXI_NAND_SECURE_STORAGE_ETHADDR
	bool "Read ethaddr from Allwinner NAND secure storage"
	depends on SUNXI_NAND_SECURE_STORAGE && NET
	select CRC32
	help
	  Read the configured secure-storage key and use it as the primary
	  Ethernet MAC address before the normal sunxi fallback environment
	  value is generated.

config SUNXI_NAND_SECURE_STORAGE_ETHADDR_KEY
	string "NAND secure-storage key name for ethaddr"
	depends on SUNXI_NAND_SECURE_STORAGE_ETHADDR
	default "mac"
	help
	  Name of the secure-storage item containing the primary Ethernet MAC
	  address. The BSP store_object payload is parsed like a U-Boot
	  Ethernet environment variable.

config SUNXI_NAND_SECURE_STORAGE_MTD_PARTS
	bool "Generate NAND mtdparts around secure storage"
	depends on SUNXI_NAND_SECURE_STORAGE && SYS_MTDPARTS_RUNTIME
	help
	  Generate the default NAND mtdparts at runtime by locating BSP
	  secure-storage marker blocks and placing the UBI partition immediately
	  after the last marker. Mark that partition for automatic UBI attachment
	  by Linux. This avoids hard-coding the secure-storage offset, which may
	  shift when bad blocks are present before or inside the BSP secure-storage
	  window. Only SLC raw NAND is supported; MLC/TLC parts need the BSP
	  LSB-block-size mapping, which is not available here.
```

## configs/whatsminer-h616_defconfig
```kconfig
CONFIG_ARM=y
CONFIG_ARCH_SUNXI=y
CONFIG_TEXT_BASE=0x4f000000
CONFIG_SYS_MALLOC_LEN=0x800000
CONFIG_DEFAULT_DEVICE_TREE="allwinner/sun50i-h616-whatsminer"
CONFIG_SPL=y
CONFIG_IDENT_STRING="WhatsMiner H616"
CONFIG_DRAM_SUNXI_DX_ODT=0x08080808
CONFIG_DRAM_SUNXI_DX_DRI=0x0e0e0e0e
CONFIG_DRAM_SUNXI_CA_DRI=0x0e0e
CONFIG_DRAM_SUNXI_TPR6=0x33808080
CONFIG_DRAM_SUNXI_TPR10=0xf83438
CONFIG_MACH_SUN50I_H616=y
CONFIG_SUNXI_DRAM_H616_DDR3_1333=y
CONFIG_DRAM_CLK=576
CONFIG_R_I2C_ENABLE=y
CONFIG_SPL_IMAGE_TYPE_SUNXI_TOC0=y
# CONFIG_SYS_MALLOC_CLEAR_ON_INIT is not set
CONFIG_STACK_SIZE=0x100000
CONFIG_BOOTCOMMAND="fatload mmc 0 0x49000000 fit.itb; bootm 0x49000000"
CONFIG_LOGLEVEL=7
CONFIG_SPL_I2C=y
CONFIG_SPL_NAND_RAW_U_BOOT_USE_SECTOR=y
CONFIG_SPL_NAND_RAW_U_BOOT_SECTOR=0x0
# CONFIG_CMD_UBI is not set
CONFIG_SPL_SYS_I2C_LEGACY=y
CONFIG_SYS_I2C_MVTWSI=y
CONFIG_SYS_I2C_SLAVE=0x7f
CONFIG_MTD=y
CONFIG_DM_MTD=y
CONFIG_MTD_RAW_NAND=y
CONFIG_SYS_NAND_BLOCK_SIZE=131072
CONFIG_SYS_NAND_ONFI_DETECTION=y
CONFIG_SYS_NAND_PAGE_SIZE=2048
CONFIG_SYS_NAND_OOBSIZE=128
CONFIG_SYS_NAND_U_BOOT_OFFS=0x10c000
CONFIG_SYS_NAND_U_BOOT_OFFS_REDUND=0x800000
CONFIG_PHY_REALTEK=y
CONFIG_PHY_ETHERNET_ID=y
CONFIG_PHY_FIXED=y
CONFIG_PHY_NCSI=y
CONFIG_SUN8I_EMAC=y
CONFIG_AXP313_POWER=y
CONFIG_AXP_DCDC2_VOLT=1100
CONFIG_CONS_INDEX=2
```
